## boards/arm/helios_nrf52840/Kconfig.board
```kconfig
# Copyright (c) 2023 Nordic Semiconductor ASA
# SPDX-License-Identifier: Apache-2.0

config BOARD_HELIOS_NRF52840
	bool "helios_nrf52840"
	depends on SOC_NRF52840_QIAA
```

## boards/arm/helios_nrf52840/Kconfig.defconfig
```kconfig
# Copyright (c) 2023 Nordic Semiconductor ASA
# SPDX-License-Identifier: Apache-2.0

if BOARD_HELIOS_NRF52840

config BOARD
	default "helios_nrf52840"

config BT_CTLR
   default BT

endif
```

## boards/arm/helios_nrf52840/helios_nrf52840_defconfig
```kconfig
# Copyright (c) 2023 Nordic Semiconductor ASA
# SPDX-License-Identifier: Apache-2.0

CONFIG_SOC_SERIES_NRF52X=y
CONFIG_SOC_NRF52840_QIAA=y
CONFIG_BOARD_HELIOS_NRF52840=y

# Enable MPU
CONFIG_ARM_MPU=y

# Enable hardware stack protection
CONFIG_HW_STACK_PROTECTION=y
# Enable RTT
CONFIG_USE_SEGGER_RTT=y

# enable PINCTRL
CONFIG_PINCTRL=y

# enable GPIO
CONFIG_GPIO=y

# enable uart driver
CONFIG_SERIAL=y
CONFIG_UART_ASYNC_API=y

# enable console
CONFIG_CONSOLE=y
CONFIG_UART_CONSOLE=y
CONFIG_RTT_CONSOLE=n

# logging
CONFIG_LOG=y
CONFIG_LOG_BACKEND_RTT=y
CONFIG_LOG_BACKEND_UART=n
CONFIG_LOG_DEFAULT_LEVEL=3

# enable USB
CONFIG_USB_DEVICE_STACK=y
CONFIG_USB_DEVICE_PRODUCT="Twopounds Helios NRF52840"
CONFIG_USB_DEVICE_PID=0x17da
CONFIG_USB_DEVICE_VID=0x366c
CONFIG_UART_INTERRUPT_DRIVEN=y
CONFIG_UART_LINE_CTRL=y
CONFIG_USB_DEVICE_INITIALIZE_AT_BOOT=y

# enable power management
CONFIG_PM=y
CONFIG_PM_DEVICE=y

# disable NFC pins
CONFIG_NFCT_PINS_AS_GPIOS=y

# disable reset pin
CONFIG_GPIO_AS_PINRESET=n
```

## build/Kconfig/Kconfig.shield
```kconfig
osource "/Users/jw/Helios-Firmware/my_helios_ble_usb_cdc/boards/shields/*/Kconfig.shield"
osource "/opt/nordic/ncs/v2.4.0/nrf/boards/shields/*/Kconfig.shield"
```

## build/Kconfig/Kconfig.shield.defconfig
```kconfig
osource "/Users/jw/Helios-Firmware/my_helios_ble_usb_cdc/boards/shields/*/Kconfig.defconfig"
osource "/opt/nordic/ncs/v2.4.0/nrf/boards/shields/*/Kconfig.defconfig"
```
